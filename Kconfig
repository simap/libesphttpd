## Kconfig
```kconfig
#ESP-IDF Kconfig configuration file. Not used for ESP8266 RTOS/non-RTOS SDKs.
menu "esphttpd"

config ESPHTTPD_STACK_SIZE
	int "Stack size of ESP-HTTPD task"
	range 1024 16384
	default 4096
	help
		Stack size reserved for the esp-httpd main task plus CGIs.

config ESPHTTPD_PROC_AFFINITY
	bool "Processor Affinity Support"
	default n
	help
		Enable Processor Affinity Support

config ESPHTTPD_PROC_CORE
	int "Bind to Processor Core"
        depends on ESPHTTPD_PROC_AFFINITY
	range 0 1
	default 0
	help
		Select Core 0 or Core 1

config ESPHTTPD_PROC_PRI
	int "Process Task Priority"
	range 1 17
	default 4
	help
		Set esphttpd Process Task Priority

config ESPHTTPD_SHUTDOWN_SUPPORT
	bool "Enable shutdown support"
	default n
	help
		Add support for server shutdown. Adds ~500 bytes of code.

config ESPHTTPD_CORS_SUPPORT
    bool "CORS support"
    help
        Enable support for CORS, cross origin resource sharing.
        NOTE: Requires 256 bytes of RAM for each connection

config ESPHTTPD_USE_ESPFS
	bool "Enable espfs integration"
	default y
	help
		Enables integration with espfs (readonly) filesystem.  You need to include espfs component in your project if enabled.

config ESPHTTPD_SO_REUSEADDR
	bool "Set SO_REUSEADDR to avoid waiting for a port in TIME_WAIT."
	default n
	help
		Requires LWIP_SO_REUSE to be enabled.

		Sets the SO_REUSEADDR flag on a socket prior to attempting to bind(). Avoids the condition where
		the bind() calls will fail while the port is in TIME_WAIT for a number of minutes.

config ESPHTTPD_TCP_NODELAY
	bool "Set TCP_NODELAY."
	default y
	help
		Set TCP_NODELAY to avoid waiting for a ACK to send multiple small frames (It will disable Nagle's TCP Algorithm).  It can speed-up transfers for small files.

config ESPHTTPD_SSL_SUPPORT
	bool "Enable SSL support"
	default n
	help
		SSL connections require ~32k of ram each.

		Enabling this allows the server to be placed into ssl mode.

config ESPHTTPD_BACKLOG_SUPPORT
	bool "Write data to backlog when it can't be sent"
	default n
	help
		A non-os specific option. FreeRTOS uses blocking sockets so data will always be sent and there is
		no need for the backlog.

		If you are using FreeRTOS you'll save codespace by leaving this option disabled.

config ESPHTTPD_SANITIZE_URLS
	bool "Sanitize client requests"
	default y
	help
		Sanitize client's URL requests by treating multiple repeated slashes in the
		URL's path as a single slash.

config ESPHTTPD_SINGLE_REQUEST
	bool "Single request per connection"
	depends on ESPHTTPD_ENABLED
	default n
	help
		Include the "Connection: close" header.  This is useful for captive portals.	

endmenu
```
